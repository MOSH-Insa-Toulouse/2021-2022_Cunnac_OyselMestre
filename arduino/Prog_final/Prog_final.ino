// ========= Initialisation Sensor ========= //

const int sensorPin = 0; //initialisation du sensorPin sur A0
int Voltage_ADC_map ; //variable contenant la tension brute mesurée par l'ADC
float Voltage_ADC ; //variable contenant la tension réelle mesurée par l'ADC

// Valeurs composants circuit 
float R1 = 100000.0;
float R2 = 1000.0;
float R3 = 100000.0;
float R5 = 10000.0;
float Vcc = 5.0;

// ========= Initialisation Bluetooth ========= //
#include <stdlib.h>
#include <string.h>
#include <stdio.h>
#include <SoftwareSerial.h>
#define rxPin 10  // Broche 10 en tant que RX, à raccorder sur TX du HC-05
#define txPin 11  // Broche 11 en tant que TX, à raccorder sur RX du HC-05
SoftwareSerial bluetooth(rxPin,txPin); // Définition du software serial pour le bluetooth

//volatile int envoi=0; // variable pour gérer l'autorisation d'envoi de données à l'appli
//volatile int menu_envoi=0;  // variable pour gérer le menu d'autorisation d'envoi de données à l'appli
volatile int reception_message_appli =0; // variable signalant la reception d'un message de l'appli

// ========= Initialisation OLED ========= //

#include <Adafruit_SSD1306.h>

// Initialisation & Paramètrages écran OLED
#define nombreDePixelsEnLargeur   128         // Taille de l'écran OLED, en pixel, au niveau de sa largeur
#define nombreDePixelsEnHauteur   64          // Taille de l'écran OLED, en pixel, au niveau de sa hauteur
#define brocheResetOLED           -1          // Reset de l'OLED partagé avec l'Arduino (d'où la valeur à -1, et non un numéro de pin)
#define adresseI2CecranOLED       0x3C        // Adresse de "mon" écran OLED sur le bus i2c (généralement égal à 0x3C ou 0x3D)
volatile Adafruit_SSD1306 ecranOLED(nombreDePixelsEnLargeur, nombreDePixelsEnHauteur, &Wire, brocheResetOLED);

// Image à afficher
#define largeurDeLimage           128          // Largeur de l'image à afficher, en pixels
#define hauteurDeLimage           64          // Hauteur de l'image à afficher, en pixels

const unsigned char imageAafficher [] PROGMEM = { // tableau codé de l'image à afficher
  0x00, 0x00, 0x00, 0x00, 0x00, 0x00, 0x00, 0x00, 0x00, 0x00, 0x00, 0x00, 0x00, 0x00, 0x00, 0x00, 
  0x00, 0x00, 0x00, 0x00, 0x00, 0x00, 0x00, 0x00, 0x00, 0x00, 0x00, 0x00, 0x00, 0x00, 0x00, 0x00, 
  0x00, 0x00, 0x00, 0x00, 0x00, 0x00, 0x00, 0x00, 0x0f, 0xfe, 0x00, 0x00, 0x00, 0x00, 0x00, 0x00, 
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  0x00, 0x00, 0x00, 0x00, 0x00, 0x00, 0x00, 0x00, 0x00, 0x00, 0x00, 0x00, 0x00, 0x00, 0x00, 0x00
};

// ========= Initialisation Encodeur Rotatoire ========= //

//Initialisation des pins
volatile const int clkPin  = 3;
volatile const int dtPin  = 4;
volatile const int swPin  = 2;

//Initialisation des variables
volatile int rotVal  = 1;
volatile bool clkState  = LOW;
volatile bool clkLast  = HIGH;
volatile bool swState  = HIGH;
volatile bool swLast  = HIGH;

volatile int choix_affichage=1;
volatile int Switch=0;
volatile int Menu=0;

// *********************************************************//
// *********************************************************//

void setup() {
  // ========= Setup Port Série ========= //
  Serial.begin(38400);
  Serial.println(F("Initialize System"));
  
  // ========= Setup Bluetooth ========= //
  pinMode(rxPin, INPUT);
  pinMode(txPin, OUTPUT);

  bluetooth.begin(9600);
  Serial.println(F("Setup BT ok"));
  
  // ========= Setup Encodeur Rotatoire ========= //
  pinMode(clkPin,INPUT);
  pinMode(dtPin,INPUT);
  pinMode(swPin,INPUT_PULLUP);

  pinMode(clkPin, INPUT_PULLUP);  // rajouté
  attachInterrupt(1,readRotary,CHANGE);  // rajouté
  attachInterrupt(0,readRotary,CHANGE);  // rajouté
  Serial.println(F("Setup Encodeur ok"));
  
  // ========= Setup OLED ========= //
  ecranOLED.clearDisplay(); 
  if(!ecranOLED.begin(SSD1306_SWITCHCAPVCC, adresseI2CecranOLED)){ while(1);  }    // Arrêt du programme (boucle infinie) en cas d'échec de l'initialisation
  ecranOLED.clearDisplay();   // Effaçage de la mémoire tampon de l'écran OLED
  delay(200);                            
  Serial.println(F("Setup oled ok"));
  
  // ========= Animation Oled Début de programme ========= //
  drawcircle();    // Draw circles (outlines)
  fillcircle();    // Draw circles (filled)
  Serial.println(F("Animation initialisation ok"));
  
  // ========= FIN Setup ========= //
  Serial.println("Fin Setup");
}

// *********************************************************//
// *********************************************************//

void loop() {
  // ========= Mesure Capteur ========= //
  Voltage_ADC_map = analogRead(sensorPin) ;
  //Serial.print("Voltage_ADC_map : "); Serial.print(Voltage_ADC_map);
  Voltage_ADC = (float) 5/1023*Voltage_ADC_map ; // transfert de la donnée brute en tension réelle
  //Serial.print("  Voltage_ADC : "); Serial.print(Voltage_ADC);
  float R_sensor = (1+R3/R2)*R1*Vcc/Voltage_ADC - R1 - R5 ; // calcul de la résistance correspondante
  //Serial.print("  Rsensor : "); Serial.println(R_sensor);
  
  // ========= Envoi donnée Appli ========= //
  int i=0;
  char message[32]={0};    
  do{
    message[i++]=bluetooth.read();
    delay(3);       
    }while (bluetooth.available() >0) ;
    
  if (strstr(message,"START_ACQUISITION")){ reception_message_appli=1; Serial.print("RéceptionMessage Start_acquisition");}   // A CHANNGEEEER
  if (strstr(message,"STOP_ACQUISITION")){ reception_message_appli=0; }

  if (reception_message_appli==1){
    bluetooth.print("0");
    bluetooth.println((long int)R_sensor);
  }

  // ========= Affichage OLED selon Encodeur Rotatoire ========= //
  
  if ((Menu==1) && (Switch==0)){  // Affichage du menu de choix
    ecranOLED.clearDisplay();
    ecranOLED.setTextSize(2); 
    ecranOLED.setCursor(0,1); 
    ecranOLED.setTextColor(SSD1306_WHITE);
    
    if (rotVal==1){ // Sélection de la 1ère ligne
      ecranOLED.setTextColor(SSD1306_BLACK,SSD1306_WHITE);
      ecranOLED.println("Resistance");
      ecranOLED.setTextColor(SSD1306_WHITE);
      ecranOLED.println("Tension");
      ecranOLED.println("Image");
      ecranOLED.println("Credits"); 
    }
    
    if (rotVal==2){ // Sélection de la 2e ligne
      ecranOLED.setTextColor(SSD1306_WHITE);
      ecranOLED.println("Resistance");
      ecranOLED.setTextColor(SSD1306_BLACK,SSD1306_WHITE);
      ecranOLED.println("Tension");
      ecranOLED.setTextColor(SSD1306_WHITE);
      ecranOLED.println("Image");
      ecranOLED.println("Credits");  
    }
    
    if (rotVal==3){ // Sélection de la 3e ligne
      ecranOLED.setTextColor(SSD1306_WHITE);
      ecranOLED.println("Resistance");
      ecranOLED.println("Tension");
      ecranOLED.setTextColor(SSD1306_BLACK,SSD1306_WHITE);
      ecranOLED.println("Image");
      ecranOLED.setTextColor(SSD1306_WHITE);
      ecranOLED.println("Credits"); 
    }
    if (rotVal==4){ // Sélection de la 4e ligne
      ecranOLED.setTextColor(SSD1306_WHITE);
      ecranOLED.println("Resistance");
      ecranOLED.println("Tension");
      ecranOLED.println("Image");
      ecranOLED.setTextColor(SSD1306_BLACK,SSD1306_WHITE);
      ecranOLED.println("Credits");   
    }
    ecranOLED.display();    
  }
  
  else{ // Affichage de l'OLED selon choix effectué dans le menu
    
    if (choix_affichage==1){  // Affichage de la valeur de la résistance
      
      affichage_OLED_resistance(R_sensor);  // affichage de la valeur sur l'écran OLED
    }
    
    if (choix_affichage==2){  // Affichage de la valeur de la tension
      affichage_OLED_tension(Voltage_ADC);  // affichage de la valeur sur l'écran OLED
      }
      
    if (choix_affichage==3){  // Affichage d'une image
      ecranOLED.clearDisplay(); 
        
      // Affichage d'une image au centre de l'écran
      ecranOLED.clearDisplay();                           // Effaçage de la mémoire tampon de l'écran OLED
    
      ecranOLED.drawBitmap(
        (ecranOLED.width()  - largeurDeLimage ) / 2,      // Position de l'extrême "gauche" de l'image (pour centrage écran, ici)
        (ecranOLED.height() - hauteurDeLimage) / 2,       // Position de l'extrême "haute" de l'image (pour centrage écran, ici)
        imageAafficher,
        largeurDeLimage,
        hauteurDeLimage,
        WHITE);                                           // "couleur" de l'image
    
      ecranOLED.display();                                // Transfert de la mémoire tampon à l'écran OLED, pour affichage  
      } 
      
    if (choix_affichage==4){  // Affichage des crédits sous forme de texte mouvant
      scrolltext();
      }

    Switch=0;
    Menu=0;
  }
  

  delay(500);
}

// *********************************************************//
// *********************************************************//

// ========= Fonction Lecture Encodeur Rotatoire ========= //

void readRotary( ) { 
    //gestion rotation
    clkState = digitalRead(clkPin);
    if ((clkLast == LOW) && (clkState == HIGH)) {//mouvement de rotation
      if (digitalRead(dtPin) == HIGH) {
        rotVal = rotVal - 1;
        if ( rotVal < 1 ) {
          rotVal = 1;
          }
      }
      else {
        rotVal++;
        if ( rotVal > 4 ) { rotVal = 4; }
      }
      
      delay(100);
      Menu=1; // activation du menu autorisation transmission données
    
    }
    clkLast = clkState;

    //gestion bouton
    swState = digitalRead(swPin);
    if (swState == LOW && swLast == HIGH) {
      if (Menu==1){choix_affichage=rotVal; Switch=1;}
      delay(100);
    }
    swLast = swState;  
}

// ========= Fonction Affichage valeur Résistance OLED ========= //

void affichage_OLED_resistance(float R_sensor){
  ecranOLED.clearDisplay();
  ecranOLED.setTextSize(3);
  ecranOLED.setCursor(15,0); 
  ecranOLED.setTextColor(SSD1306_WHITE); 
  ecranOLED.print("R");
  ecranOLED.setTextSize(2);
  ecranOLED.print("capteur");
  ecranOLED.setTextSize(3);
  ecranOLED.println("");
  R_sensor = R_sensor/1000000 ; 
  ecranOLED.print(" ");
  ecranOLED.println(R_sensor);
  ecranOLED.print("  M");
  ecranOLED.setTextSize(2);
  ecranOLED.print("ohm");

  ecranOLED.display();
}


// ========= Fonction Affichage valeur Tension OLED ========= //

void affichage_OLED_tension(float V_adc){
  ecranOLED.clearDisplay();
  ecranOLED.setTextSize(3);
  ecranOLED.setCursor(35,0); 
  ecranOLED.setTextColor(SSD1306_WHITE); 
  ecranOLED.print("V");
  ecranOLED.setTextSize(2);
  ecranOLED.print("adc");
  ecranOLED.setTextSize(3);
  ecranOLED.println("");
  ecranOLED.print(" ");
  ecranOLED.print(V_adc);
  ecranOLED.println(" V");
  ecranOLED.display();
}


// ========= Fonction Affichage Scroll Text ========= //

void scrolltext(void) {
  ecranOLED.clearDisplay();

  ecranOLED.setTextSize(2); // Draw 2X-scale text
  ecranOLED.setTextColor(SSD1306_WHITE);
  ecranOLED.setCursor(1, 0);
  ecranOLED.println(F("Alex O.M."));
  ecranOLED.println(F("Yohan C."));
  ecranOLED.println(F("4GP INSA"));
  ecranOLED.display();      // Show initial text
  delay(100);

  // Scroll in various directions, pausing in-between:
  ecranOLED.startscrollright(0x00, 0x0F);
  delay(2000);
  ecranOLED.stopscroll();
  delay(1000);
  ecranOLED.startscrollleft(0x00, 0x0F);
  delay(2000);
  ecranOLED.stopscroll();
  delay(1000);
  ecranOLED.startscrolldiagright(0x00, 0x07);
  delay(2000);
  ecranOLED.startscrolldiagleft(0x00, 0x07);
  delay(2000);
  ecranOLED.stopscroll();
  delay(1000);
}


// ========= Fonctions Affichage Animations ========= //

void drawcircle(void) {
  ecranOLED.clearDisplay();

  for(int16_t i=0; i<max(ecranOLED.width(),ecranOLED.height())/2; i+=2) {
    ecranOLED.drawCircle(ecranOLED.width()/2, ecranOLED.height()/2, i, SSD1306_WHITE);
    ecranOLED.display();
    delay(20);
  }

  delay(1000);
}

void fillcircle(void) {
  ecranOLED.clearDisplay();

  for(int16_t i=max(ecranOLED.width(),ecranOLED.height())/2; i>0; i-=3) {
    // La couleur INVERSE est utilisée pour alterner les cercles blanc et noir
    ecranOLED.fillCircle(ecranOLED.width() / 2, ecranOLED.height() / 2, i, SSD1306_INVERSE);
    ecranOLED.display();
    delay(100);
  }

  delay(1500);
}
